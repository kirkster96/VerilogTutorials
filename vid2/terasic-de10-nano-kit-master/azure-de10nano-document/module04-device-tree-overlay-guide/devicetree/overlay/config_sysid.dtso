/dts-v1/;
/plugin/; 
/ { 
        fragment@0 { 
                target-path = "/soc/base-fpga-region"; 
                #address-cells = <1>; 
                #size-cells = <1>; 

                __overlay__ { 

                        firmware-name = "LHoWa_TPat.rbf";

                        fpga-bridges = <&fpga_bridge0 &fpga_bridge1>;

                        #address-cells = <2>; 
                        #size-cells = <1>; 
                        ranges = <0xc0000000 0x00000000 0xc0000000 0x20000000>,
                                 <0xff200000 0x00000000 0xff200000 0x00200000>;

                        sysid_qsys: sysid@0xff201000 {
                                compatible = "altr,sysid-16.0", "altr,sysid-1.0";
                                reg = <0xff200000 0x00001000 0x00000008>;
                        }; //end sysid_qsys

                }; //overlay
        }; //fragment
};
